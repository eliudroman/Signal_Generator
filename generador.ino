#include <LiquidCrystal.h>

// Inicializar la biblioteca con los números de los pines
LiquidCrystal lcd(A5, A4, A0, A1, A2, 13);

const int cambioPin = 11;
const int enterPin = 12;

const int frecuenciaPin = A7;
const int amplitudPin = A6;
const int offsetPin = A3;

const PROGMEM byte R2RLookup_Sine[256] = {
  0x80,0x83,0x86,0x89,0x8c,0x8f,0x92,0x95,0x98,0x9c,0x9f,0xa2,0xa5,0xa8,0xab,0xae,
  0xb0,0xb3,0xb6,0xb9,0xbc,0xbf,0xc1,0xc4,0xc7,0xc9,0xcc,0xce,0xd1,0xd3,0xd5,0xd8,
  0xda,0xdc,0xde,0xe0,0xe2,0xe4,0xe6,0xe8,0xea,0xec,0xed,0xef,0xf0,0xf2,0xf3,0xf5,
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  0x4f,0x51,0x54,0x57,0x5a,0x5d,0x60,0x63,0x67,0x6a,0x6d,0x70,0x73,0x76,0x79,0x7c
};


const PROGMEM byte R2RLookup_Sawtooth[256] =
{
0x00,0x01,0x02,0x03,0x04,0x05,0x06,0x07,0x08,0x09,0x0a,0x0b,0x0c,0x0d,0x0e,0x0f,
0x10,0x11,0x12,0x13,0x14,0x15,0x16,0x17,0x18,0x19,0x1a,0x1b,0x1c,0x1d,0x1e,0x1f,
0x20,0x21,0x22,0x23,0x24,0x25,0x26,0x27,0x28,0x29,0x2a,0x2b,0x2c,0x2d,0x2e,0x2f,
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0xf0,0xf1,0xf2,0xf3,0xf4,0xf5,0xf6,0xf7,0xf8,0xf9,0xfa,0xfb,0xfc,0xfd,0xfe,0xff
};


const PROGMEM byte R2RLookup_Square[256] = {
  0xFF, 0xFF, 0xFF, 0xFF, 0xFF, 0xFF, 0xFF, 0xFF, // Alto
  0xFF, 0xFF, 0xFF, 0xFF, 0xFF, 0xFF, 0xFF, 0xFF, // Alto
  0xFF, 0xFF, 0xFF, 0xFF, 0xFF, 0xFF, 0xFF, 0xFF, // Alto
  0xFF, 0xFF, 0xFF, 0xFF, 0xFF, 0xFF, 0xFF, 0xFF, // Alto
  0x00, 0x00, 0x00, 0x00, 0x00, 0x00, 0x00, 0x00, // Bajo
  0x00, 0x00, 0x00, 0x00, 0x00, 0x00, 0x00, 0x00, // Bajo
  0x00, 0x00, 0x00, 0x00, 0x00, 0x00, 0x00, 0x00, // Bajo
  0x00, 0x00, 0x00, 0x00, 0x00, 0x00, 0x00, 0x00, // Bajo
  0xFF, 0xFF, 0xFF, 0xFF, 0xFF, 0xFF, 0xFF, 0xFF, // Alto
  0xFF, 0xFF, 0xFF, 0xFF, 0xFF, 0xFF, 0xFF, 0xFF, // Alto
  0xFF, 0xFF, 0xFF, 0xFF, 0xFF, 0xFF, 0xFF, 0xFF, // Alto
  0xFF, 0xFF, 0xFF, 0xFF, 0xFF, 0xFF, 0xFF, 0xFF, // Alto
  0x00, 0x00, 0x00, 0x00, 0x00, 0x00, 0x00, 0x00, // Bajo
  0x00, 0x00, 0x00, 0x00, 0x00, 0x00, 0x00, 0x00, // Bajo
  0x00, 0x00, 0x00, 0x00, 0x00, 0x00, 0x00, 0x00, // Bajo
  0x00, 0x00, 0x00, 0x00, 0x00, 0x00, 0x00, 0x00  // Bajo
};


enum Mode {
  SINE,
  RAMP,
  SQUARE
};

Mode currentMode = SINE;

float SNR(float factorEscala) {
  float signalPower = pow(255.0 * factorEscala, 2) / 2;
  float noisePower = pow(5.0 / 255.0, 2) / 12;
  float snr = 10 * log10(signalPower / noisePower);
  return snr;
}



void setup() {
  pinMode(cambioPin, INPUT);
  pinMode(enterPin, INPUT);

  pinMode(frecuenciaPin, INPUT);
  pinMode(amplitudPin, INPUT);
  pinMode(offsetPin, INPUT);

  pinMode(2, OUTPUT);
  pinMode(3, OUTPUT);
  pinMode(4, OUTPUT);
  pinMode(5, OUTPUT);
  pinMode(6, OUTPUT);
  
  pinMode(7, OUTPUT);
  pinMode(8, OUTPUT);
  pinMode(9, OUTPUT);

  lcd.begin(16, 2);

  displayMenu();
}

void loop() {
  static bool cambioButtonPressed = false;
  static bool enterButtonPressed = false;

  if (digitalRead(cambioPin) == HIGH) {
    if (!cambioButtonPressed) {
      cambioButtonPressed = true;
      // Cambiar entre modos
      currentMode = (Mode)((currentMode + 1) % 3);
      displayMenu();
    }
  } else {
    cambioButtonPressed = false;
  }

  if (digitalRead(enterPin) == HIGH) {
    if (!enterButtonPressed) {
      enterButtonPressed = true;
      // Comienza a generar la señal
      generateSignal();
    }
  } else {
    enterButtonPressed = false;
  }
}

void displayMenu() {
  lcd.clear(); // Borra todo el contenido del LCD
  lcd.setCursor(0, 0);

  switch (currentMode) {
    case SINE:
      lcd.print("Modo: Seno");
      break;
    case RAMP:
      lcd.print("Modo: Rampa");
      break;
    case SQUARE:
      lcd.print("Modo: Cuadrada");
      break;
  }

  lcd.setCursor(0, 1);
  lcd.print("Presiona Enter");
}

void generateSignal() {
  lcd.clear();
  
  switch (currentMode) {
    case SINE:
      
      
      while(digitalRead(cambioPin) == LOW){
        lcd.setCursor(0, 0);
        lcd.print("Seno");
        int amplitud = analogRead(amplitudPin);  // Lee el valor del pin de amplitud (0-1023)
        float factorEscala = amplitud / 1023.0;  // Calcula el factor de escala (0.0-1.0)
        float Offset = analogRead(offsetPin) / 1023.0;
        int frecuencia = 0.01 + (10 * analogRead(frecuenciaPin) / 1023.0);

        float SnrActual = SNR(factorEscala);
        lcd.setCursor(0, 1);
        lcd.print("SNR= ");
        lcd.print(SnrActual);
        Serial.println(SnrActual);
        for (int i = 0; i < 256; i++) {
          byte valorOriginal = pgm_read_byte(&R2RLookup_Sine[i]);
          byte valorEscalado = valorOriginal * factorEscala + Offset;
          PORTD = valorEscalado;  // Aplica el valor escalado a los pines de salida
          delayMicroseconds(frecuencia);
          //delay(250);
        }
        lcd.clear();
      }
      break;
    case RAMP:
      while(digitalRead(cambioPin) == LOW){
        lcd.setCursor(0, 0);
        lcd.print("Rampa");
        int amplitud = analogRead(amplitudPin);  // Lee el valor del pin de amplitud (0-1023)
        float factorEscala = amplitud / 1023.0;  // Calcula el factor de escala (0.0-1.0)
        int frecuencia = 0.01 + (10 * analogRead(frecuenciaPin) / 1023.0);

        float SnrActual = SNR(factorEscala);
        lcd.setCursor(0, 1);
        lcd.print("SNR= ");
        lcd.print(SnrActual);
        Serial.println(SnrActual);
        for (int i = 0; i < 256; i++) {
          byte valorOriginal = pgm_read_byte(&R2RLookup_Sawtooth[i]);
          byte valorEscalado = valorOriginal * factorEscala;
          PORTD = valorEscalado;  // Aplica el valor escalado a los pines de salida
          delayMicroseconds(frecuencia);
          //delay(250);
        }
        lcd.clear();
      }
      
      break;
    case SQUARE:
      while(digitalRead(cambioPin) == LOW){
        lcd.setCursor(0, 0);
        lcd.print("Cuadrada");
        int amplitud = analogRead(amplitudPin);  // Lee el valor del pin de amplitud (0-1023)
        float factorEscala = amplitud / 1023.0;  // Calcula el factor de escala (0.0-1.0)
        int frecuencia = 0.01 + (10 * analogRead(frecuenciaPin) / 1023.0);

        float SnrActual = SNR(factorEscala);
        lcd.setCursor(0, 1);
        lcd.print("SNR= ");
        lcd.print(SnrActual);
        Serial.println(SnrActual);
        for (int i = 0; i < 256; i++) {
          byte valorOriginal = pgm_read_byte(&R2RLookup_Square[i]);
          byte valorEscalado = valorOriginal * factorEscala;
          PORTD = valorEscalado;  // Aplica el valor escalado a los pines de salida
          delayMicroseconds(frecuencia);
          //delay(250);
        }
        lcd.clear();
      }
      
      break;
  }
  displayMenu();
}
